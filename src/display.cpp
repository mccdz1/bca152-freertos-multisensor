#include "display.h"
#include "rtos_objects.h"
#include "system_state.h"
#include "input.h"
#include "alarm.h"
#include <string.h>
#include <stdio.h>
#include "driver/i2c.h"
#include "freertos/FreeRTOS.h"
#include "freertos/task.h"

#define I2C_PORT I2C_NUM_0

static uint8_t display_buffer[1024]; // 128 columns * 8 pages
static SensorData latest_data = { 24.5f, 60.0f, 50, false };
static bool is_display_on = true;

/* Standard 8x8 Basic ASCII font (subset for ASCII 32-126) */
static const uint8_t font8x8[96][8] = {
    {0x00,0x00,0x00,0x00,0x00,0x00,0x00,0x00}, // ' '
    {0x18,0x3C,0x3C,0x18,0x18,0x00,0x18,0x00}, // '!'
    {0x66,0x66,0x24,0x00,0x00,0x00,0x00,0x00}, // '"'
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    {0x00,0x00,0x00,0x00,0x00,0x00,0x00,0x00}  // 127
};

static void ssd1306_send_cmd(uint8_t cmd)
{
    uint8_t buf[2] = { 0x00, cmd };
    i2c_master_write_to_device(I2C_PORT, OLED_I2C_ADDR, buf, sizeof(buf), pdMS_TO_TICKS(50));
}

void display_set_power(bool on)
{
    if (on != is_display_on) {
        ssd1306_send_cmd(on ? 0xAF : 0xAE);
        is_display_on = on;
    }
}

static void ssd1306_clear_buffer(void)
{
    memset(display_buffer, 0x00, sizeof(display_buffer));
}

static void ssd1306_draw_char(int x, int page, char c)
{
    if (c < 32 || c > 127) c = ' ';
    if (page < 0 || page >= 8) return;
    int idx = c - 32;

    for (int col = 0; col < 8; col++) {
        int x_pos = x + col;
        if (x_pos >= 0 && x_pos < 128) {
            uint8_t byte = 0;
            for (int bit = 0; bit < 8; bit++) {
                if (font8x8[idx][bit] & (1 << (7 - col))) {
                    byte |= (1 << bit);
                }
            }
            display_buffer[page * 128 + x_pos] = byte;
        }
    }
}

static void ssd1306_draw_string(int x, int page, const char *str)
{
    int cur_x = x;
    while (*str && cur_x < 128) {
        ssd1306_draw_char(cur_x, page, *str);
        cur_x += 8;
        str++;
    }
}

static void ssd1306_update(void)
{
    if (!is_display_on) return;

    for (uint8_t page = 0; page < 8; page++) {
        ssd1306_send_cmd(0xB0 + page); // Set page start address
        ssd1306_send_cmd(0x00);        // Set lower column address
        ssd1306_send_cmd(0x10);        // Set higher column address

        uint8_t data[129];
        data[0] = 0x40; // Co=0, D/C#=1
        memcpy(&data[1], &display_buffer[page * 128], 128);
        i2c_master_write_to_device(I2C_PORT, OLED_I2C_ADDR, data, sizeof(data), pdMS_TO_TICKS(50));
    }
}

void display_init(void)
{
    i2c_config_t conf = {};
    conf.mode = I2C_MODE_MASTER;
    conf.sda_io_num = PIN_OLED_SDA;
    conf.scl_io_num = PIN_OLED_SCL;
    conf.sda_pullup_en = GPIO_PULLUP_ENABLE;
    conf.scl_pullup_en = GPIO_PULLUP_ENABLE;
    conf.master.clk_speed = 400000;
    i2c_param_config(I2C_PORT, &conf);
    i2c_driver_install(I2C_PORT, conf.mode, 0, 0, 0);

    /* SSD1306 Initialization sequence */
    ssd1306_send_cmd(0xAE); // Display OFF
    ssd1306_send_cmd(0xD5); // Set Display Clock Divide Ratio
    ssd1306_send_cmd(0x80);
    ssd1306_send_cmd(0xA8); // Set Multiplex Ratio (64)
    ssd1306_send_cmd(0x3F);
    ssd1306_send_cmd(0xD3); // Set Display Offset (0)
    ssd1306_send_cmd(0x00);
    ssd1306_send_cmd(0x40); // Set Start Line (0)
    ssd1306_send_cmd(0x8D); // Charge Pump Setting
    ssd1306_send_cmd(0x14); // Enable Charge Pump
    ssd1306_send_cmd(0x20); // Memory Addressing Mode
    ssd1306_send_cmd(0x00); // Horizontal Addressing
    ssd1306_send_cmd(0xA1); // Segment Re-map
    ssd1306_send_cmd(0xC8); // COM Output Scan Direction
    ssd1306_send_cmd(0xDA); // COM Pins Hardware Config
    ssd1306_send_cmd(0x12);
    ssd1306_send_cmd(0x81); // Contrast Control
    ssd1306_send_cmd(0xCF);
    ssd1306_send_cmd(0xD9); // Pre-charge Period
    ssd1306_send_cmd(0xF1);
    ssd1306_send_cmd(0xDB); // VCOMH Deselect Level
    ssd1306_send_cmd(0x40);
    ssd1306_send_cmd(0xA4); // Output Follows RAM Content
    ssd1306_send_cmd(0xA6); // Normal Display
    ssd1306_send_cmd(0xAF); // Display ON

    is_display_on = true;
    ssd1306_clear_buffer();
    ssd1306_draw_string(16, 1, "ROOM MONITOR");
    ssd1306_draw_string(24, 4, "System Init...");
    ssd1306_update();
}

void display_update_sensor_data(const SensorData *data)
{
    if (data != nullptr) {
        latest_data = *data;
    }
}

void display_task(void *pvParameters)
{
    char val_str[24];
    char info_str[24];
    SensorData queue_reading;

    for (;;) {
        /* Check if a new sensor reading arrived via queue without blocking long */
        if (xQueueReceive(sensorQueue, &queue_reading, pdMS_TO_TICKS(150)) == pdTRUE) {
            display_update_sensor_data(&queue_reading);
        }

        SystemState current_state = get_current_system_state();

        if (current_state == SystemState::INACTIVE) {
            /* Blank/turn off display in power-saving INACTIVE mode */
            if (is_display_on) {
                ssd1306_clear_buffer();
                ssd1306_update();
                display_set_power(false);
                safe_log("DISPLAY", "OLED turned OFF for power saving (INACTIVE)");
            }
            vTaskDelay(pdMS_TO_TICKS(300));
            continue;
        }

        /* If returning to ACTIVE, restore power */
        if (!is_display_on) {
            display_set_power(true);
            safe_log("DISPLAY", "OLED restored ON (ACTIVE)");
        }

        DisplayMode mode = input_get_display_mode();
        ssd1306_clear_buffer();

        /* Header (Step 22: ROOM MONITOR) */
        ssd1306_draw_string(16, 0, "ROOM MONITOR");
        ssd1306_draw_string(0, 1, "----------------");

        switch (mode) {
            case DisplayMode::TEMPERATURE:
                ssd1306_draw_string(16, 3, "Temperature");
                snprintf(val_str, sizeof(val_str), "  %.1f C", latest_data.temperature);
                ssd1306_draw_string(20, 5, val_str);
                if (evaluateTemperature(latest_data.temperature) != AlarmState::NORMAL) {
                    ssd1306_draw_string(16, 7, "* ALARM ACTIVE *");
                } else {
                    ssd1306_draw_string(24, 7, "State: NORMAL");
                }
                break;

            case DisplayMode::HUMIDITY:
                ssd1306_draw_string(28, 3, "Humidity");
                snprintf(val_str, sizeof(val_str), "  %.1f %%", latest_data.humidity);
                ssd1306_draw_string(20, 5, val_str);
                ssd1306_draw_string(20, 7, "RH Level: Good");
                break;

            case DisplayMode::LIGHT:
                ssd1306_draw_string(20, 3, "Light Level");
                snprintf(val_str, sizeof(val_str), "   %d %%", latest_data.lightLevel);
                ssd1306_draw_string(20, 5, val_str);
                snprintf(info_str, sizeof(info_str), "Illum: %s", latest_data.lightLevel > 50 ? "Bright" : "Dim");
                ssd1306_draw_string(16, 7, info_str);
                break;

            case DisplayMode::MOTION:
                ssd1306_draw_string(16, 3, "Motion Status");
                if (latest_data.motionDetected) {
                    ssd1306_draw_string(24, 5, ">> DETECTED <<");
                    ssd1306_draw_string(16, 7, "Room is ACTIVE");
                } else {
                    ssd1306_draw_string(28, 5, "NO MOTION");
                    ssd1306_draw_string(20, 7, "Room Idle");
                }
                break;
        }

        ssd1306_update();
        vTaskDelay(pdMS_TO_TICKS(150));
    }
}
